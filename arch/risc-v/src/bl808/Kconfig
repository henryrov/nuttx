## arch/risc-v/src/bl808/Kconfig
```kconfig
#
# For a description of the syntax of this configuration file,
# see the file kconfig-language.txt in the NuttX tools repository.
#

comment "BL808 Configuration Options"

menu "BL808 Peripheral Support"

config BL808_GPADC
	bool "GPADC"
	default n

choice BL808_GPADC_RES
	prompt "GPADC Resolution"
	default BL808_GPADC_RES_12
	depends on BL808_GPADC

config BL808_GPADC_RES_12
	bool "12 bits"

config BL808_GPADC_RES_14
	bool "14 bits"

config BL808_GPADC_RES_16
	bool "16 bits"

endchoice

config BL808_UART0
	bool "UART 0"
	default n
	select UART0_SERIALDRIVER
	select ARCH_HAVE_SERIAL_TERMIOS

config BL808_UART1
	bool "UART 1"
	default n
	select UART1_SERIALDRIVER
	select ARCH_HAVE_SERIAL_TERMIOS

config BL808_UART2
	bool "UART 2"
	default n
	select UART2_SERIALDRIVER
	select ARCH_HAVE_SERIAL_TERMIOS

config BL808_UART3
	bool "UART 3"
	default n
	select UART3_SERIALDRIVER
	select ARCH_HAVE_SERIAL_TERMIOS

endmenu
```
